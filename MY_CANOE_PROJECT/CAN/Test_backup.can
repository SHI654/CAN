includes
{
  
}

variables
{


}
On message *
{
  write("***0x%x",this.id);
}